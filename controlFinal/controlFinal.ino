#include <avr/pgmspace.h>
#define MAX 1023
#define MIN 0
#define MAX_OUT 255
#define MAX_TIME 4294967296

int yPin = 0, setPointPin = 1, pwmPin = 9;
double lastError = 0, inputNow, output, error, integralPartial = 0, derivativePartial;
double kp = 2, ki = .05, kd = .2;
unsigned long startTime, Ts = 10;
int setPoint, readInt;

// this LUT calculates the sin of an angle from (0 input - > 0 degrees) to (1023 input -> 90 degrees)
const int sin_lut[1024] PROGMEM = {0,2,3,5,6,8,9,11,13,14,16,17,19,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1023,1023};

int values[200], count = 0;

void setup() {
  Serial.begin(9600);
  pinMode(pwmPin, OUTPUT);
  pinMode(yPin, INPUT);
}

void loop() {
  
  startTime = millis();

  // read the input
  setPoint = analogRead(setPointPin);
  // calculete the sin of the input
  setPoint = pgm_read_word_near(sin_lut+setPoint);

  // read the sensor and set it to wanted the range (*3.6)
  readInt = fixRange(analogRead(yPin)*3.6); // 1023 = 90 degrees
  // calculate the sin of the sensor
  inputNow = pgm_read_word_near(sin_lut+readInt);

  // calculate the error
  error = setPoint - inputNow;
  
  // calculate integral part
  integralPartial += error;
  // calculate derivative part
  derivativePartial = error - lastError;

  // output to motor is the sum of parts
  output = kp * error + ki*integralPartial + kd*derivativePartial;

  // write output to pwm
  analogWrite(pwmPin, fixRangeOutput(output/4));

  // save error for derivative part
  lastError  = error;

  // check for error in sample time
  if (millis() -startTime > Ts) {
    Serial.println("too much fs");
  }

  if (count < 200){
    values[count] = inputNow;
    count++;
  }
  else if (count == 200){
    for (int i=0; i<200; i++){
      Serial.print(values[i]);
      Serial.print(", ");
    }
    Serial.println();
    count++;
  }

  startTime = millis();
  // wait to execute next step
  delay(Ts - timeDiff(millis(), startTime));
   

}

double fixRange(double a){
  if (a>MAX) return MAX;
  if (a<MIN) return MIN;
  return a;
}

double fixRangeOutput(double a){
  if (a>MAX_OUT) return MAX_OUT;
  if (a<0) return 0;
  return a;
}

unsigned long timeDiff(unsigned long now, unsigned long before){
  if (now>=before) return now - before;
  else return now + MAX_TIME -before;
}

